## arch/arm64/configs/exynos7904-base_defconfig
```kconfig
# CONFIG_USELIB is not set
CONFIG_AUDIT=y
CONFIG_NO_HZ=y
CONFIG_HIGH_RES_TIMERS=y
CONFIG_IKCONFIG=y
CONFIG_IKCONFIG_PROC=y
CONFIG_CGROUPS=y
CONFIG_CGROUP_DEBUG=y
CONFIG_CGROUP_FREEZER=y
CONFIG_CGROUP_CPUACCT=y
CONFIG_CGROUP_SCHED=y
CONFIG_RT_GROUP_SCHED=y
CONFIG_OLAF_SUPPORT=y
CONFIG_NAMESPACES=y
CONFIG_UTS_NS=y
CONFIG_BLK_DEV_INITRD=y
CONFIG_CC_OPTIMIZE_FOR_SIZE=y
CONFIG_EMBEDDED=y
# CONFIG_COMPAT_BRK is not set
CONFIG_PROFILING=y
CONFIG_MODULES=y
CONFIG_MODULE_UNLOAD=y
CONFIG_MODVERSIONS=y
# CONFIG_BLK_DEV_BSG is not set
CONFIG_PARTITION_ADVANCED=y
# CONFIG_IOSCHED_DEADLINE is not set
CONFIG_SOC_EXYNOS7885=y
CONFIG_SOC_EXYNOS7884=y
CONFIG_SOC_EXYNOS7885_ANDROID_VERSION_P=y
CONFIG_ARCH_EXYNOS7=y
CONFIG_SCHED_MC=y
CONFIG_DISABLE_CPU_SCHED_DOMAIN_BALANCE=y
CONFIG_SCHED_HMP=y
CONFIG_HMP_FAST_CPU_MASK="6-7"
CONFIG_HMP_SLOW_CPU_MASK="0-5"
CONFIG_HMP_VARIABLE_SCALE=y
CONFIG_SCHED_HMP_TASK_BASED_SOFTLANDING=y
CONFIG_SCHED_HMP_SELECTIVE_BOOST_WITH_NITP=y
CONFIG_SCHED_SKIP_CORE_SELECTION_MASK=y
CONFIG_NR_CPUS=8
CONFIG_NR_CLUSTERS=3
CONFIG_PREEMPT=y
CONFIG_KSM=y
CONFIG_CMA_SIZE_MBYTES=20
CONFIG_CMA_DEBUGFS=y
CONFIG_HPA=y
CONFIG_ARMV8_DEPRECATED=y
CONFIG_SWP_EMULATION=y
CONFIG_CP15_BARRIER_EMULATION=y
CONFIG_SETEND_EMULATION=y
# CONFIG_EFI is not set
# CONFIG_CORE_DUMP_DEFAULT_ELF_HEADERS is not set
CONFIG_COMPAT=y
CONFIG_PM_AUTOSLEEP=y
CONFIG_PM_WAKELOCKS=y
CONFIG_CPU_IDLE=y
CONFIG_ARM64_EXYNOS_CPUIDLE=y
CONFIG_CPU_FREQ=y
CONFIG_CPU_FREQ_DEFAULT_GOV_INTERACTIVE=y
CONFIG_CPU_INDEX_QOS_CLUSTER1=6
CONFIG_CPU_FREQ_GOV_PERFORMANCE=y
CONFIG_CPU_FREQ_GOV_USERSPACE=y
CONFIG_ARM_EXYNOS_ACME=y
CONFIG_ARM_EXYNOS_UFC=y
CONFIG_NET=y
CONFIG_USB_USBNET=y
CONFIG_USB_NET_AX8817X=y
CONFIG_USB_NET_AX88179_178A=y
CONFIG_USB_NET_CDCETHER=y
CONFIG_USB_NET_CDC_NCM=y
CONFIG_USB_NET_NET1080=y
CONFIG_USB_NET_CDC_SUBSET=y
CONFIG_USB_BELKIN=y
CONFIG_USB_ARMLINUX=y
CONFIG_USB_NET_ZAURUS=y
CONFIG_USB_NET_SMSC75XX=y
CONFIG_USB_NET_SMSC95XX=y
CONFIG_USB_RTL8152=y
CONFIG_USB_RTL8150=y
CONFIG_USB_NET_CDC_EEM=y
CONFIG_USB_NET_CDC_MBIM=y
CONFIG_USB_SERIAL=y
CONFIG_USB_SERIAL_FTDI_SIO=y
CONFIG_USB_SERIAL_PL2303=y
CONFIG_PACKET=y
CONFIG_UNIX=y
CONFIG_XFRM_USER=y
CONFIG_NET_KEY=y
CONFIG_INET=y
CONFIG_IP_MULTICAST=y
CONFIG_IP_ADVANCED_ROUTER=y
CONFIG_IP_MULTIPLE_TABLES=y
CONFIG_IP_PNP=y
CONFIG_IP_PNP_DHCP=y
CONFIG_IP_PNP_BOOTP=y
CONFIG_IP_PNP_RARP=y
CONFIG_INET_AH=y
CONFIG_INET_ESP=y
CONFIG_INET_IPCOMP=y
CONFIG_INET_XFRM_MODE_BEET=y
# CONFIG_INET_LRO is not set
CONFIG_INET_DIAG=y
CONFIG_INET_UDP_DIAG=y
CONFIG_INET_DIAG_DESTROY=y
#TCP Congestion Control Change to BIC
CONFIG_TCP_CONG_ADVANCED=y
CONFIG_TCP_CONG_BIC=y
CONFIG_TCP_CONG_WESTWOOD=y
CONFIG_TCP_CONG_HTCP=y
CONFIG_DEFAULT_BIC=y
CONFIG_DEFAULT_TCP_CONG="bic"
CONFIG_IPV6=y
CONFIG_IPV6_ROUTER_PREF=y
CONFIG_IPV6_ROUTE_INFO=y
CONFIG_IPV6_OPTIMISTIC_DAD=y
CONFIG_INET6_AH=y
CONFIG_INET6_ESP=y
CONFIG_INET6_IPCOMP=y
CONFIG_IPV6_MIP6=y
CONFIG_IPV6_TUNNEL=y
CONFIG_IPV6_MULTIPLE_TABLES=y
CONFIG_NETFILTER=y
CONFIG_NF_CONNTRACK=y
CONFIG_NF_CONNTRACK_SECMARK=y
CONFIG_NF_CONNTRACK_EVENTS=y
CONFIG_NF_CT_PROTO_DCCP=y
CONFIG_NF_CT_PROTO_SCTP=y
CONFIG_NF_CT_PROTO_UDPLITE=y
CONFIG_NF_CONNTRACK_AMANDA=y
CONFIG_NF_CONNTRACK_FTP=y
CONFIG_NF_CONNTRACK_H323=y
CONFIG_NF_CONNTRACK_IRC=y
CONFIG_NF_CONNTRACK_NETBIOS_NS=y
CONFIG_NF_CONNTRACK_PPTP=y
CONFIG_NF_CONNTRACK_SANE=y
CONFIG_NF_CONNTRACK_TFTP=y
CONFIG_NF_CT_NETLINK=y
CONFIG_NETFILTER_XT_TARGET_CLASSIFY=y
CONFIG_NETFILTER_XT_TARGET_CONNMARK=y
CONFIG_NETFILTER_XT_TARGET_CONNSECMARK=y
CONFIG_NETFILTER_XT_TARGET_CT=y
CONFIG_NETFILTER_XT_TARGET_IDLETIMER=y
CONFIG_NETFILTER_XT_TARGET_LOG=y
CONFIG_NETFILTER_XT_TARGET_MARK=y
CONFIG_NETFILTER_XT_TARGET_NFLOG=y
CONFIG_NETFILTER_XT_TARGET_NFQUEUE=y
CONFIG_NETFILTER_XT_TARGET_TPROXY=y
CONFIG_NETFILTER_XT_TARGET_TRACE=y
CONFIG_NETFILTER_XT_TARGET_SECMARK=y
CONFIG_NETFILTER_XT_TARGET_TCPMSS=y
CONFIG_NETFILTER_XT_MATCH_COMMENT=y
CONFIG_NETFILTER_XT_MATCH_CONNBYTES=y
CONFIG_NETFILTER_XT_MATCH_CONNLABEL=y
CONFIG_NETFILTER_XT_MATCH_CONNLIMIT=y
CONFIG_NETFILTER_XT_MATCH_CONNMARK=y
CONFIG_NETFILTER_XT_MATCH_CONNTRACK=y
CONFIG_NETFILTER_XT_MATCH_HASHLIMIT=y
CONFIG_NETFILTER_XT_MATCH_HELPER=y
CONFIG_NETFILTER_XT_MATCH_IPRANGE=y
CONFIG_NETFILTER_XT_MATCH_LENGTH=y
CONFIG_NETFILTER_XT_MATCH_LIMIT=y
CONFIG_NETFILTER_XT_MATCH_MAC=y
CONFIG_NETFILTER_XT_MATCH_MARK=y
CONFIG_NETFILTER_XT_MATCH_POLICY=y
CONFIG_NETFILTER_XT_MATCH_PKTTYPE=y
CONFIG_NETFILTER_XT_MATCH_QTAGUID=y
CONFIG_NETFILTER_XT_MATCH_QUOTA=y
CONFIG_NETFILTER_XT_MATCH_QUOTA2=y
CONFIG_NETFILTER_XT_MATCH_QUOTA2_LOG=y
CONFIG_NETFILTER_XT_MATCH_SCTP=y
CONFIG_NETFILTER_XT_MATCH_SOCKET=y
CONFIG_NETFILTER_XT_MATCH_STATE=y
CONFIG_NETFILTER_XT_MATCH_STATISTIC=y
CONFIG_NETFILTER_XT_MATCH_STRING=y
CONFIG_NETFILTER_XT_MATCH_TIME=y
CONFIG_NETFILTER_XT_MATCH_U32=y
CONFIG_NF_CONNTRACK_IPV4=y
CONFIG_IP_NF_IPTABLES=y
CONFIG_IP_NF_MATCH_AH=y
CONFIG_IP_NF_MATCH_ECN=y
CONFIG_IP_NF_MATCH_RPFILTER=y
CONFIG_IP_NF_MATCH_TTL=y
CONFIG_IP_NF_FILTER=y
CONFIG_IP_NF_TARGET_REJECT=y
CONFIG_IP_NF_NAT=y
CONFIG_IP_NF_TARGET_MASQUERADE=y
CONFIG_IP_NF_TARGET_NETMAP=y
CONFIG_IP_NF_TARGET_REDIRECT=y
CONFIG_IP_NF_MANGLE=y
CONFIG_IP_NF_RAW=y
CONFIG_IP_NF_SECURITY=y
CONFIG_IP_NF_ARPTABLES=y
CONFIG_IP_NF_ARPFILTER=y
CONFIG_IP_NF_ARP_MANGLE=y
CONFIG_NET_IPVTI=y
CONFIG_NF_CONNTRACK_IPV6=y
CONFIG_IP6_NF_IPTABLES=y
CONFIG_IP6_NF_MATCH_RPFILTER=y
CONFIG_IP6_NF_FILTER=y
CONFIG_IP6_NF_TARGET_REJECT=y
CONFIG_IP6_NF_MANGLE=y
CONFIG_IP6_NF_RAW=y
CONFIG_IP6_NF_NAT=y
CONFIG_IP6_NF_TARGET_MASQUERADE=y
CONFIG_IPV6_VTI=y
CONFIG_PHONET=y
CONFIG_NET_SCHED=y
CONFIG_NET_SCH_HTB=y
CONFIG_NET_SCH_INGRESS=y
CONFIG_NET_CLS_U32=y
CONFIG_NET_EMATCH=y
CONFIG_NET_EMATCH_U32=y
CONFIG_NET_CLS_ACT=y
CONFIG_NET_ACT_POLICE=y
CONFIG_NET_ACT_GACT=y
CONFIG_NET_ACT_MIRRED=y
CONFIG_CFG80211=y
CONFIG_CFG80211_REG_NOT_UPDATED=y
CONFIG_UEVENT_HELPER_PATH="/sbin/hotplug"
CONFIG_DEVTMPFS=y
CONFIG_FW_LOADER_USER_HELPER_FALLBACK=y
CONFIG_BLK_DEV_LOOP=y
CONFIG_BLK_DEV_RAM=y
CONFIG_BLK_DEV_RAM_SIZE=8192
CONFIG_UID_SYS_STATS=y
CONFIG_MCU_IPC=y
CONFIG_SHM_IPC=y
CONFIG_USIM_DETECT=y
CONFIG_SEC_SIPC_MODEM_IF=y
CONFIG_MODEM_IF_QOS=y
CONFIG_NF_HISTORY=y
CONFIG_NETFILTER_XT_MATCH_ONESHOT=y
# CONFIG_CP_ZEROCOPY is not set
CONFIG_CP_UART_NOTI=y
CONFIG_PMU_UART_SWITCH=y
CONFIG_GNSS_SHMEM_IF=y

CONFIG_SCSC_STATIC_RING=y
CONFIG_SCSC_STATIC_RING_SIZE=4194304

CONFIG_SCSC_MMAP=y
CONFIG_SCSC_DBG_SAMPLER=n
CONFIG_SCSC_CHV_SUPPORT=n
CONFIG_SCSC_GPR4_CON_DEBUG=n
CONFIG_SCSC_WLAN_HIP4_PROFILING=n
CONFIG_SCSC_WLAN_DEBUG=n
CONFIG_SCSC_WLAN_MUTEX_DEBUG=n
CONFIG_SCSC_WLAN_HANG_TEST=n
CONFIG_SCSC_CLK20MHZ_TEST=n

CONFIG_SCSC_CORE_CM=y
CONFIG_SCSC_CORE=y
CONFIG_SCSC_WLBTD=y
CONFIG_SCSC_WRITE_INFO_FILE_WLBTD=y
CONFIG_SCSC_CORE_FW_LOCATION="/system/etc/wifi"
CONFIG_SCSC_PLATFORM=y
CONFIG_SCSC_CM_MX_CLIENT_TEST=n
CONFIG_SCSC_CLK20MHZ=n
CONFIG_SAMSUNG_KIC=n
CONFIG_SLSI_KIC_API_ENABLED=n
CONFIG_SCSC_WIFILOGGER=y
CONFIG_SCSC_WIFILOGGER_DEBUGFS=y
CONFIG_SCSC_WIFILOGGER_TEST=n
CONFIG_SCSC_BT=y
CONFIG_SCSC_ANT=y
CONFIG_SCSC_WLAN=y
CONFIG_SCSC_WLBT_CONFIG_PLATFORM="lassen_univ"
CONFIG_SCSC_WLAN_SG=y
CONFIG_SCSC_WLAN_KEY_MGMT_OFFLOAD=y
CONFIG_SCSC_WLAN_PSCHED_AMSDU=y
CONFIG_SCSC_WLAN_ANDROID=y
CONFIG_SCSC_WLAN_MHS_STATIC_INTERFACE=y

CONFIG_SCSC_WLAN_KIC_OPS=n
CONFIG_SCSC_WLAN_GSCAN_ENABLE=y
CONFIG_SCSC_WLAN_WES_NCHO=y
CONFIG_SCSC_WLAN_MAC_ADDRESS_FILENAME="/efs/wifi/.mac.info"
CONFIG_SCSC_WLAN_FIRST_5G_CHANNEL_SCAN=y
CONFIG_SCSC_WLAN_AP_INFO_FILE=y
CONFIG_SCSC_WLAN_ENABLE_MAC_RANDOMISATION=y
CONFIG_SCSC_BUILD_TYPE="User"
CONFIG_USE_MUIC=y
CONFIG_MUIC_NOTIFIER=y
CONFIG_VBUS_NOTIFIER=y
CONFIG_SCSI=y
CONFIG_BLK_DEV_SD=y
CONFIG_MD=y
CONFIG_BLK_DEV_DM=y
CONFIG_DM_CRYPT=y
CONFIG_DM_UEVENT=y
CONFIG_DM_VERITY=y
CONFIG_DM_VERITY_FEC=y
CONFIG_DM_ANDROID_VERITY_AT_MOST_ONCE_DEFAULT_ENABLED=y
CONFIG_KNOX_KAP=y
CONFIG_NETDEVICES=y
CONFIG_TUN=y
CONFIG_PPP=y
CONFIG_PPP_DEFLATE=y
CONFIG_PPP_BSDCOMP=y
CONFIG_PPP_MPPE=y
CONFIG_PPPOLAC=y
CONFIG_PPPOPNS=y

CONFIG_INPUT_EVDEV=y
CONFIG_INPUT_KEYRESET=y
CONFIG_KEYBOARD_GPIO=y
CONFIG_KEYBOARD_SAMSUNG=y
CONFIG_KEYBOARD_ABOV_TOUCH_3X6=y
CONFIG_TOUCHKEY_GRIP=y
# CONFIG_INPUT_MOUSE is not set
CONFIG_INPUT_JOYSTICK=y
CONFIG_INPUT_TABLET=y
CONFIG_INPUT_TOUCHSCREEN=y
CONFIG_TOUCHSCREEN_SEC_TS=y
CONFIG_TOUCHSCREEN_SEC_TS_GLOVEMODE=y
CONFIG_TOUCHSCREEN_DUMP_MODE=y
CONFIG_SEC_DEBUG_TSP_LOG=y
CONFIG_INPUT_MISC=y
CONFIG_INPUT_KEYCHORD=y
CONFIG_INPUT_UINPUT=y
CONFIG_INPUT_GPIO=y
# CONFIG_SERIO_SERPORT is not set
# CONFIG_VT is not set
# CONFIG_LEGACY_PTYS is not set
# CONFIG_DEVMEM is not set
# CONFIG_DEVKMEM is not set
CONFIG_SERIAL_SAMSUNG=y
CONFIG_SERIAL_SAMSUNG_CONSOLE=y
CONFIG_S3C_LOWLEVEL_UART_PORT=2
CONFIG_HW_RANDOM=y
# CONFIG_HW_RANDOM_EXYNOS is not set
CONFIG_EXYRNG_FIPS_COMPLIANCE=y
CONFIG_EXYRNG_FAIL_POLICY_RESET=y
CONFIG_EXYRNG_USE_CRYPTOMANAGER=y
CONFIG_I2C_CHARDEV=y
CONFIG_I2C_GPIO=y
CONFIG_I2C_S3C2410=y
CONFIG_SPI=y
CONFIG_SPI_S3C64XX=y
CONFIG_PINCTRL_EXYNOS=y
CONFIG_GPIOLIB=y
CONFIG_SENSORS_SEC_THERMISTOR=y
CONFIG_THERMAL=y
CONFIG_CPU_THERMAL=y
CONFIG_GPU_THERMAL=y
CONFIG_THERMAL_EMULATION=y
CONFIG_EXYNOS_THERMAL=y
CONFIG_WATCHDOG=y
CONFIG_S3C2410_WATCHDOG=y
CONFIG_MFD_S2MPU08=y
CONFIG_REGULATOR_FIXED_VOLTAGE=y
CONFIG_REGULATOR_S2MPU08=y
CONFIG_MEDIA_SUPPORT=y
CONFIG_MEDIA_CAMERA_SUPPORT=y
CONFIG_MEDIA_RADIO_SUPPORT=y
CONFIG_V4L_PLATFORM_DRIVERS=y
CONFIG_VIDEO_EXYNOS_G2D1SHOT=y
CONFIG_VIDEO_EXYNOS_SCALER=y
CONFIG_VIDEO_EXYNOS_MFC=y
CONFIG_VIDEO_EXYNOS_SMFC=y
CONFIG_VIDEO_EXYNOS_FIMC_IS2=y
CONFIG_FIMC_IS_DDK_DATA_LOAD=y
CONFIG_USE_CSI_DMAOUT_FEATURE=y
CONFIG_USE_SENSOR_GROUP=y
CONFIG_RADIO_S5E7885=y
CONFIG_RADIO_S610=y
CONFIG_MALI_TMIX=y
CONFIG_MALI_MIDGARD=y
CONFIG_MALI_DEBUG_SYS=y
CONFIG_MALI_PLATFORM_THIRDPARTY_NAME="exynos"
CONFIG_EXYNOS_SOC_NAME="7885"
CONFIG_MALI_SYSTRACE_SUPPORT=y
CONFIG_MALI_PM_QOS=y
CONFIG_MALI_EXYNOS_TRACE=y
CONFIG_MALI_GPU_CORE_MASK_SELECTION=y
CONFIG_FB=y
CONFIG_FB_SIMPLE=y
CONFIG_EXYNOS_VIDEO=y
CONFIG_EXYNOS_MIPI_DSI=y
CONFIG_FB_WINDOW_UPDATE=y
CONFIG_DECON_HIBER=y
CONFIG_DPU_20=y
CONFIG_EXYNOS_DECON_LCD=y
CONFIG_BACKLIGHT_LCD_SUPPORT=y
CONFIG_LCD_CLASS_DEVICE=y
CONFIG_BACKLIGHT_CLASS_DEVICE=y
# CONFIG_BACKLIGHT_GENERIC is not set
CONFIG_SOUND=y
CONFIG_SND=y
CONFIG_SND_USB_AUDIO=y
CONFIG_USB_AUDIO=y
CONFIG_SND_USB_MIDI=y
CONFIG_SND_DYNAMIC_MINORS=y
CONFIG_SND_SOC=y
CONFIG_SND_SOC_SAMSUNG_AUDIO=y
CONFIG_SND_SOC_SAMSUNG_EXYNOS7885=y
CONFIG_SND_SOC_SAMSUNG_EXYNOS7885_COD3035=y
CONFIG_NEW_LEDS=y
CONFIG_LEDS_CLASS=y
CONFIG_SWITCH=y
CONFIG_HIDRAW=y
CONFIG_HID_OVR=y
CONFIG_UHID=y
CONFIG_HID_A4TECH=y
CONFIG_HID_ACRUX=y
CONFIG_HID_ACRUX_FF=y
CONFIG_HID_APPLE=y
CONFIG_HID_BELKIN=y
CONFIG_HID_CHERRY=y
CONFIG_HID_CHICONY=y
CONFIG_HID_PRODIKEYS=y
CONFIG_HID_CYPRESS=y
CONFIG_HID_DRAGONRISE=y
CONFIG_DRAGONRISE_FF=y
CONFIG_HID_EMS_FF=y
CONFIG_HID_ELECOM=y
CONFIG_HID_EZKEY=y
CONFIG_HID_KEYTOUCH=y
CONFIG_HID_KYE=y
CONFIG_HID_WALTOP=y
CONFIG_HID_GYRATION=y
CONFIG_HID_TWINHAN=y
CONFIG_HID_KENSINGTON=y
CONFIG_HID_LCPOWER=y
CONFIG_HID_LOGITECH=y
CONFIG_HID_LOGITECH_DJ=y
CONFIG_LOGITECH_FF=y
CONFIG_LOGIRUMBLEPAD2_FF=y
CONFIG_LOGIG940_FF=y
CONFIG_HID_MAGICMOUSE=y
CONFIG_HID_MICROSOFT=y
CONFIG_HID_MONTEREY=y
CONFIG_HID_MULTITOUCH=y
CONFIG_HID_NINTENDO=y
CONFIG_HID_MADCATZ=y
CONFIG_HID_ORTEK=y
CONFIG_HID_PANTHERLORD=y
CONFIG_PANTHERLORD_FF=y
CONFIG_HID_PETALYNX=y
CONFIG_HID_PICOLCD=y
CONFIG_HID_PRIMAX=y
CONFIG_HID_SAITEK=y
CONFIG_HID_SAMSUNG=y
CONFIG_HID_SYNAPTICS_BT=y
CONFIG_HID_SPEEDLINK=y
CONFIG_HID_SUNPLUS=y
CONFIG_HID_GREENASIA=y
CONFIG_GREENASIA_FF=y
CONFIG_HID_SMARTJOYPLUS=y
CONFIG_SMARTJOYPLUS_FF=y
CONFIG_HID_TIVO=y
CONFIG_HID_TOPSEED=y
CONFIG_HID_THRUSTMASTER=y
CONFIG_HID_ZEROPLUS=y
CONFIG_HID_ZYDACRON=y
CONFIG_USB_HMT_SAMSUNG_INPUT=y
CONFIG_DRAGONRISE_FF=y
CONFIG_GREENASIA_FF=y
CONFIG_HID_GREENASIA=y
CONFIG_HID_HOLTEK=y
CONFIG_HID_NTRIG=y
CONFIG_HID_ROCCAT=y
CONFIG_HID_SMARTJOYPLUS=y
CONFIG_HID_SONY=y
CONFIG_SONY_FF=y
CONFIG_HID_SYNAPTICS_BT=y
CONFIG_HID_THRUSTMASTER=y
CONFIG_HID_TIVO=y
CONFIG_HID_TOPSEED=y
CONFIG_HID_UCLOGIC=y
CONFIG_HID_WACOM=y
CONFIG_HID_WIIMOTE=y
CONFIG_HID_ZEROPLUS=y
CONFIG_HID_ZYDACRON=y
CONFIG_JOYSTICK_XPAD_FF=y
CONFIG_JOYSTICK_XPAD_LEDS=y
CONFIG_JOYSTICK_XPAD=y
CONFIG_TABLET_USB_ACECAD=y
CONFIG_TABLET_USB_AIPTEK=y
CONFIG_TABLET_USB_GTCO=y
CONFIG_TABLET_USB_HANWANG=y
CONFIG_TABLET_USB_KBTAB=y
CONFIG_TABLET_USB_WACOM=y
CONFIG_UHID=y
CONFIG_USB_HIDDEV=y
CONFIG_USB=y
CONFIG_USB_DEBUG=y
CONFIG_USB_XHCI_HCD=y
CONFIG_USB_PRINTER=y
CONFIG_USB_STORAGE=y
CONFIG_USB_HOST_NOTIFY=y
CONFIG_USB_STORAGE_DETECT=y
CONFIG_USB_DEBUG_DETAILED_LOG=y
CONFIG_USB_ANNOUNCE_NEW_DEVICES=y
CONFIG_USB_NOTIFY_LAYER=y
CONFIG_USB_NOTIFY_PROC_LOG=y
CONFIG_USB_OTG_WHITELIST_FOR_MDM=y
CONFIG_USB_HOST_SAMSUNG_FEATURE=y
CONFIG_USB_NOTIFIER=y
CONFIG_USB_EXTERNAL_NOTIFY=y
CONFIG_USB_DWC3=y
CONFIG_USB_GADGET=y
CONFIG_USB_CONFIGFS=y
CONFIG_USB_CONFIGFS_ACM=y
CONFIG_USB_CONFIGFS_RNDIS=y
CONFIG_USB_CONFIGFS_F_FS=y
CONFIG_USB_CONFIGFS_F_DM=y
CONFIG_USB_CONFIGFS_F_ADB=y
CONFIG_USB_CONFIGFS_F_MTP=y
CONFIG_USB_CONFIGFS_F_PTP=y
CONFIG_USB_CONFIGFS_F_CONN_GADGET=y
CONFIG_USB_CONFIGFS_F_MIDI=y
CONFIG_USB_CONFIGFS_F_ACC=y
CONFIG_USB_CONFIGFS_F_AUDIO_SRC=y
CONFIG_USB_CONFIGFS_NCM=y
CONFIG_USB_CONFIGFS_UEVENT=y
CONFIG_USB_RNDIS_MULTIPACKET=y
CONFIG_USB_G_ANDROID=y
CONFIG_USB_ANDROID_SAMSUNG_COMPOSITE=y
CONFIG_USB_DUN_SUPPORT=y
# CONFIG_USB_RNDIS_MULTIPACKET_WITH_TIMER is not set
CONFIG_USB_ACM=y
CONFIG_USBIRQ_BALANCING_LTE_HIGHTP=y
CONFIG_USB_NCM_SUPPORT_MTU_CHANGE=y
CONFIG_MMC=y
CONFIG_MMC_DW=y
CONFIG_MMC_DW_IDMAC=y
CONFIG_MMC_DW_64BIT_DESC=y
CONFIG_MMC_DW_EXYNOS=y
CONFIG_MMC_DW_DEBUG=y
CONFIG_MMC_DW_EXYNOS_FMP=y
CONFIG_MMC_DW_EXYNOS_SMU=y
CONFIG_MMC_DW_FORCE_32BIT_SFR_RW=y
CONFIG_MMC_BLOCK_DEFERRED_RESUME=y
CONFIG_MMC_CQ_HCI=y
CONFIG_MMC_SRPMB=y
CONFIG_RTC_CLASS=y
CONFIG_RTC_HIGH_RES=y
CONFIG_RTC_DRV_S2MPU08=y
CONFIG_STAGING=y
CONFIG_ASHMEM=y
CONFIG_ANDROID_TIMED_GPIO=y
CONFIG_ANDROID_LOW_MEMORY_KILLER=y
CONFIG_SYNC=y
CONFIG_SW_SYNC=y
CONFIG_SW_SYNC_USER=y
CONFIG_ANDROID_INTF_ALARM_DEV=y
CONFIG_ION=y
CONFIG_ION_TEST=n
CONFIG_ION_EXYNOS=y
CONFIG_EXYNOS_IOMMU=y
CONFIG_SOC_SAMSUNG=y
CONFIG_EXYNOS_CHIPID=y
CONFIG_EXYNOS_PMU=y
CONFIG_EXYNOS_REBOOT=y
CONFIG_ECT=y
CONFIG_ECT_DUMP=y
CONFIG_EXYNOS_PD=y
CONFIG_EXYNOS_RGT=y
CONFIG_CAL_IF=y
CONFIG_CP_PMUCAL=y
CONFIG_CMUCAL_DEBUG=y
CONFIG_CMUCAL_QCH_IGNORE_SUPPORT=y
CONFIG_USI=y
CONFIG_EXYNOS_KERNEL_PROTECTION=y
CONFIG_EXYNOS_ACPM=y
CONFIG_EXYNOS_DVFS_MANAGER=y
CONFIG_PM_DEVFREQ=y
CONFIG_ARM_EXYNOS_DEVFREQ=y
CONFIG_ARM_EXYNOS_DEVFREQ_DEBUG=y
CONFIG_IIO=y
CONFIG_EXYNOS_ADC=y
CONFIG_PWM=y
CONFIG_PWM_SAMSUNG=y
CONFIG_BATTERY_SAMSUNG=y
CONFIG_BATTERY_SWELLING=y
CONFIG_BATTERY_NOTIFIER=y
# CONFIG_PHY_EXYNOS_MIPI_VIDEO is not set
CONFIG_PHY_EXYNOS_MIPI=y
# CONFIG_PHY_EXYNOS_DP_VIDEO is not set
CONFIG_PHY_EXYNOS_USBDRD3=y
CONFIG_ANDROID=y
CONFIG_ANDROID_BINDER_IPC=y
# CONFIG_EXYNOS_CONSOLE_DEBUGGER is not set
# CONFIG_EXYNOS_SNAPSHOT_SPINLOCK is not set
CONFIG_EXYNOS_SNAPSHOT_REGULATOR=y
# CONFIG_EXYNOS_SNAPSHOT_I2C is not set
# CONFIG_EXYNOS_SNAPSHOT_SPI is not set
CONFIG_SECURE_OS_CONTROL=y
CONFIG_SECURE_OS_BOOSTER_API=y
CONFIG_EXT2_FS=y
CONFIG_EXT3_FS=y
CONFIG_EXT4_FS_SECURITY=y
CONFIG_EXT4_ENCRYPTION=y
CONFIG_EXT4_PRIVATE_ENCRYPTION=y
CONFIG_F2FS_FS=y
CONFIG_F2FS_FS_SECURITY=y
CONFIG_F2FS_FS_ENCRYPTION=y
#CONFIG_F2FS_CHECK_FS=y
CONFIG_JOURNAL_DATA_TAG=y
CONFIG_QUOTA=y
CONFIG_QUOTA_NETLINK_INTERFACE=y
CONFIG_QFMT_V2=y
CONFIG_FUSE_FS=y
CONFIG_MSDOS_FS=y
CONFIG_VFAT_FS=y
CONFIG_TMPFS=y
CONFIG_TMPFS_POSIX_ACL=y
CONFIG_ECRYPT_FS=y
CONFIG_CRAMFS=y
CONFIG_NLS_CODEPAGE_437=y
CONFIG_NLS_ISO8859_1=y
CONFIG_PRINTK_TIME=y
CONFIG_PRINTK_PROCESS=y
CONFIG_DEBUG_INFO=y
CONFIG_LOCKUP_DETECTOR=y
CONFIG_MAGIC_SYSRQ=y
CONFIG_BOOTPARAM_HARDLOCKUP_PANIC=y
CONFIG_BOOTPARAM_SOFTLOCKUP_PANIC=y
CONFIG_PANIC_TIMEOUT=5
CONFIG_ENABLE_DEFAULT_TRACERS=y
CONFIG_STRICT_DEVMEM=y
CONFIG_SECURITY_PERF_EVENTS_RESTRICT=y
CONFIG_SECURITY=y
CONFIG_SECURITYFS=y
CONFIG_SECURITY_NETWORK=y
CONFIG_HARDENED_USERCOPY=y
CONFIG_SECURITY_SELINUX=y
CONFIG_SECURITY_SELINUX_BOOTPARAM=y
CONFIG_EXYNOS_SMU=y
CONFIG_EXYNOS_FMP=y
# CONFIG_EXYNOS_FMP_FIPS is not set
CONFIG_ARM64_CRYPTO=y
CONFIG_CRYPTO_SHA1_ARM64_CE=y
CONFIG_CRYPTO_SHA2_ARM64_CE=y
CONFIG_CRYPTO_AES_ARM64_CE_BLK=y
CONFIG_CRYPTO_SHA512=y
CONFIG_CRYPTO_GCM=y

# SEC NAD
CONFIG_SEC_NAD=y
CONFIG_SEC_SUPPORT_SECOND_NAD=y
CONFIG_SEC_NAD_BALANCER=y
CONFIG_SEC_NAD_API=y
# SEC Connector detector driver
CONFIG_SEC_CONNECTOR_DETECTOR=y

# SEC Param
CONFIG_SEC_PARAM=y
CONFIG_CM_OFFSET=7340596

# FMM
CONFIG_FMM_LOCK_OFFSET=7340680

# [ SEC_SELINUX_PORTING_EXYNOS
CONFIG_EXT2_FS_XATTR=y
CONFIG_EXT2_FS_SECURITY=y
CONFIG_EXT4_FS_XATTR=y
CONFIG_EXT4_FS_SECURITY=y
CONFIG_F2FS_FS_XATTR=y
CONFIG_F2FS_FS_SECURITY=y
CONFIG_AUDIT=y
CONFIG_SECURITY=y
CONFIG_LSM_MMAP_MIN_ADDR=4096
CONFIG_SECURITY_NETWORK=y
CONFIG_SECURITY_SELINUX=y
CONFIG_DEFAULT_SECURITY_SELINUX=y
CONFIG_NETWORK_SECMARK=y
CONFIG_NETFILTER_XT_TARGET_CONNSECMARK=y
CONFIG_NETFILTER_ADVANCED=y
CONFIG_IP_NF_SECURITY=y
CONFIG_AUDITSYSCALL=y
CONFIG_SEC_AVC_LOG=y
#CONFIG_PROC_AVC=y
CONFIG_SDCARD_FS_XATTR=y
CONFIG_ECRYPT_FS_VIRTUAL_FAT_XATTR=y
CONFIG_FAT_VIRTUAL_XATTR=y
CONFIG_EXFAT_VIRTUAL_XATTR=y
# ] SEC_SELINUX_PORTING_EXYNOS

#EPDG
CONFIG_NET_CORE=y
CONFIG_NET_SCH_PRIO=y
#CONFIG_NET_SCHED=y   #depends on CONFIG_NET  which is enabled by default.. coz not seeing in the config file
CONFIG_NET_CLS_BASIC=y # required if basic is being used as a filter. depends on CONFIG_NET_CLS so enabling it by default
CONFIG_NET_CLS=y
#CONFIG_NET_CLS_ACT=y # for enabling the action target.
#CONFIG_NET_ACT_MIRRED=y  # for enabling the mirred target for redirecting the packet between the devices.
#CONFIG_NET_EMATCH=y   #basic uses extended matches so this has to be present
#CONFIG_NET_SCH_INGRESS=y # classifier for ingress packet
#EPDG
# SDP and DLP
CONFIG_SDP=y
CONFIG_EXT4CRYPT_SDP=y
CONFIG_DLP=y
# TIMA
CONFIG_TIMA=y
CONFIG_TIMA_LKMAUTH=y
CONFIG_TIMA_LKM_BLOCK=y
# CONFIG_ARM_PATCH_PHYS_VIRT is not set
# CONFIG_FUNCTION_TRACER is not set
CONFIG_TZ_ICCC=y

# WLANRFTEST
CONFIG_CFG80211_WEXT=y
CONFIG_CFG80211_WEXT_EXPORT=y
CONFIG_WEXT_CORE=y
CONFIG_WEXT_PROC=y

# from android/configs/android-recommended.cfg
CONFIG_DEBUG_RODATA=y
CONFIG_ARM64_PAN=y
CONFIG_UNMAP_KERNEL_AT_EL0=y
CONFIG_KALLSYMS_ALL=y
CONFIG_PM_DEBUG=y
CONFIG_SCHEDSTATS=y
CONFIG_TASK_DELAY_ACCT=y
CONFIG_TASK_IO_ACCOUNTING=y
CONFIG_TASKSTATS=y
CONFIG_TASK_XACCT=y
CONFIG_TIMER_STATS=y
# CONFIG_DEBUG_PREEMPT is not set

#ARGOS DRIVER
CONFIG_ARGOS=y

# ODE and DIR Encryption
CONFIG_CRYPTO_TWOFISH=y
CONFIG_CRYPTO=y
CONFIG_CRYPTO_SHA1=y
CONFIG_CRYPTO_SHA256=y
CONFIG_CRYPTO_AES=y
CONFIG_CRYPTO_CBC=y
CONFIG_CRYPTO_ECHAINIV=y
CONFIG_ECRYPT_FS=y
CONFIG_WTL_ENCRYPTION_FILTER=y
CONFIG_KEYS=y
CONFIG_KEYS_DEBUG_PROC_KEYS=y
CONFIG_ECRYPTFS_FEK_INTEGRITY=y
CONFIG_XFRM_STATISTICS=y

# UH
CONFIG_UH=y
CONFIG_UH_RKP=y
CONFIG_RKP_KDP=y
CONFIG_RKP_NS_PROT=y
CONFIG_RKP_DMAP_PROT=y

CONFIG_RKP_TEST=y
CONFIG_KDP_TEST=y

# KASLR
# CONFIG_RELOCATABLE_KERNEL is not set
CONFIG_RANDOMIZE_BASE=y

CONFIG_SEC_DUMP_SUMMARY=y
CONFIG_LOG_BUF_SHIFT=19

#BarTender
CONFIG_CPUSETS=y
CONFIG_FAIR_GROUP_SCHED=y 
CONFIG_CFS_BANDWIDTH=y

# STI
CONFIG_SEC_STI=y
# ABC
CONFIG_SEC_ABC=y
# CONFIG_SEC_ABC_HUB is not set
# CONFIG_SEC_ABC_HUB_COND is not set
# CONFIG_SEC_ABC_HUB_BOOTC is not set

# Rooting prevention
#
CONFIG_SEC_RESTRICT_ROOTING=y
CONFIG_SEC_RESTRICT_SETUID=y
CONFIG_SEC_RESTRICT_FORK=y
CONFIG_SEC_RESTRICT_ROOTING_LOG=y

#FreeCess
CONFIG_SAMSUNG_FREECESS=y

# MEMCG
CONFIG_MEMCG=y
CONFIG_MEMCG_SWAP=y

CONFIG_FRAME_WARN=4096
```
