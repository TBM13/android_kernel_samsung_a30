## arch/arm64/configs/exynos7884-eng_defconfig
```kconfig
#
# Kernel Performance Events and Counters
#
CONFIG_SLUB_DEBUG=y

#
# printk and dmesg options
#
CONFIG_DYNAMIC_DEBUG=y
# CONFIG_PAGE_OWNER is not set

# Memory Debugging
#
CONFIG_DEBUG_PAGEALLOC=y
CONFIG_DEBUG_OBJECTS=y
CONFIG_DEBUG_OBJECTS_FREE=y
CONFIG_DEBUG_OBJECTS_TIMERS=y
CONFIG_DEBUG_OBJECTS_WORK=y
CONFIG_DEBUG_OBJECTS_RCU_HEAD=y
CONFIG_DEBUG_OBJECTS_PERCPU_COUNTER=y
CONFIG_SLUB_DEBUG_ON=y
CONFIG_DEBUG_KMEMLEAK=y
CONFIG_DEBUG_KMEMLEAK_EARLY_LOG_SIZE=8000
CONFIG_DEBUG_KMEMLEAK_DEFAULT_OFF=y
CONFIG_DEBUG_STACK_USAGE=y
CONFIG_DEBUG_MEMORY_INIT=y

#
# Debug Lockups and Hangs
#
CONFIG_SCHEDSTATS=y
CONFIG_SCHED_STACK_END_CHECK=y
CONFIG_TIMER_STATS=y
CONFIG_DEBUG_PREEMPT=y

#
# Lock Debugging (spinlocks, mutexes, etc...)
#
CONFIG_DEBUG_RT_MUTEXES=y
CONFIG_DEBUG_SPINLOCK=y
CONFIG_DEBUG_MUTEXES=y
CONFIG_DEBUG_LOCK_ALLOC=y
CONFIG_PROVE_LOCKING=y
CONFIG_DEBUG_ATOMIC_SLEEP=y
CONFIG_DEBUG_LIST=y
CONFIG_DEBUG_PI_LIST=y
CONFIG_DEBUG_SG=y

#
# DS5 enable setup
#
# CONFIG_HW_PERF_EVENTS=y
# CONFIG_MALI_GATOR_SUPPORT=y
# CONFIG_GATOR_WITH_MALI_SUPPORT=y
# CONFIG_GATOR_MALI_MIDGARD=y
# CONFIG_GATOR=y

#
# Runtime Testing
#
CONFIG_LKDTM=y
CONFIG_ATOMIC64_SELFTEST=y
#CONFIG_DEBUG_RODATA is not set

#
# Memory Watcher & MMIO Trace
#
# CONFIG_SEC_MMIOTRACE is not set
# CONFIG_SEC_KWATCHER=y

#
# Support T32 onchip breakpoint
#
CONFIG_SKIP_HW_BREAKPOINT=y

#
# GPIO DVS
#
CONFIG_SEC_GPIO_DVS=y

# SENSORHUB Debug
CONFIG_SSP_ENG_DEBUG=y

#
# WIFI Debugging
#
CONFIG_SCSC_MMAP=y
CONFIG_SCSC_DBG_SAMPLER=y
CONFIG_SCSC_DEBUG=y
CONFIG_SCSC_DEBUG_COMPATIBILITY=y
CONFIG_SCSC_STATIC_RING=y
CONFIG_SCSC_STATIC_RING_SIZE=4194304
CONFIG_SCSC_CHV_SUPPORT=y
CONFIG_SCSC_GPR4_CON_DEBUG=y
CONFIG_SCSC_WLAN_HIP4_PROFILING=y
CONFIG_SCSC_WLAN_DEBUG=y
CONFIG_SCSC_WLAN_MUTEX_DEBUG=y
CONFIG_SCSC_WLAN_HANG_TEST=y
CONFIG_SCSC_CLK20MHZ_TEST=Y
CONFIG_SCSC_BUILD_TYPE="Engineering"

# Security
# CONFIG_TIMA_LKMAUTH is not set
# CONFIG_TIMA_LKM_BLOCK is not set

#
# USB Debugging
#
CONFIG_PHY_EXYNOS_DEBUGFS=y

#
# Battery driver
#
CONFIG_ENG_BATTERY_CONCEPT=y

# Support S.LSI debugging framework
CONFIG_EPX=y

#
# DO NOT REMOVE THE LAST BLANK LINE
#
```

## arch/arm64/configs/exynos7884-userdebug_defconfig
```kconfig
# CONFIG_RKP_KDP is not set

# streamline
CONFIG_PROFILING=y
CONFIG_PERF_EVENTS=y
CONFIG_HIGH_RES_TIMERS=y
CONFIG_HW_PERF_EVENTS=y
CONFIG_LOCAL_TIMERS=y

CONFIG_GATOR=y
```

## arch/arm64/configs/exynos7885-userdebug_defconfig
```kconfig
# Rooting prevention
#
# CONFIG_SEC_RESTRICT_ROOTING=y
# CONFIG_SEC_RESTRICT_SETUID=y
# CONFIG_SEC_RESTRICT_FORK=y
# CONFIG_SEC_RESTRICT_ROOTING_LOG=y

# CONFIG_RKP_KDP is not set

# streamline
CONFIG_PROFILING=y
CONFIG_PERF_EVENTS=y
CONFIG_HIGH_RES_TIMERS=y
CONFIG_HW_PERF_EVENTS=y
CONFIG_LOCAL_TIMERS=y

CONFIG_GATOR=y
```

## arch/arm64/configs/exynos7885_defconfig
```kconfig
# CONFIG_SWAP is not set
CONFIG_AUDIT=y
CONFIG_NO_HZ=y
CONFIG_HIGH_RES_TIMERS=y
CONFIG_CGROUPS=y
CONFIG_CGROUP_DEBUG=y
CONFIG_CGROUP_FREEZER=y
CONFIG_CGROUP_CPUACCT=y
CONFIG_CGROUP_SCHED=y
CONFIG_RT_GROUP_SCHED=y
CONFIG_NAMESPACES=y
CONFIG_BLK_DEV_INITRD=y
CONFIG_CC_OPTIMIZE_FOR_SIZE=y
CONFIG_EMBEDDED=y
# CONFIG_COMPAT_BRK is not set
CONFIG_PROFILING=y
# CONFIG_BLK_DEV_BSG is not set
CONFIG_PARTITION_ADVANCED=y
# CONFIG_IOSCHED_DEADLINE is not set
CONFIG_SOC_EXYNOS7885=y
CONFIG_ARCH_EXYNOS7=y
CONFIG_SCHED_MC=y
CONFIG_NR_CPUS=8
CONFIG_NR_CLUSTERS=3
CONFIG_PREEMPT=y
CONFIG_ARMV8_DEPRECATED=y
CONFIG_SWP_EMULATION=y
CONFIG_CP15_BARRIER_EMULATION=y
CONFIG_SETEND_EMULATION=y
# CONFIG_EFI is not set
# CONFIG_CORE_DUMP_DEFAULT_ELF_HEADERS is not set
CONFIG_COMPAT=y
CONFIG_PM_AUTOSLEEP=y
CONFIG_PM_WAKELOCKS=y
CONFIG_CPU_IDLE=y
CONFIG_ARM64_EXYNOS_CPUIDLE=y
CONFIG_NET=y
CONFIG_PACKET=y
CONFIG_UNIX=y
CONFIG_NET_KEY=y
CONFIG_INET=y
CONFIG_IP_ADVANCED_ROUTER=y
CONFIG_IP_MULTIPLE_TABLES=y
CONFIG_IP_PNP=y
CONFIG_IP_PNP_DHCP=y
CONFIG_IP_PNP_BOOTP=y
CONFIG_IP_PNP_RARP=y
CONFIG_INET_ESP=y
# CONFIG_INET_XFRM_MODE_BEET is not set
# CONFIG_INET_LRO is not set
# CONFIG_INET_DIAG is not set
CONFIG_IPV6_ROUTER_PREF=y
CONFIG_IPV6_ROUTE_INFO=y
CONFIG_IPV6_OPTIMISTIC_DAD=y
CONFIG_INET6_AH=y
CONFIG_INET6_ESP=y
CONFIG_INET6_IPCOMP=y
CONFIG_IPV6_MIP6=y
CONFIG_IPV6_TUNNEL=y
CONFIG_IPV6_MULTIPLE_TABLES=y
CONFIG_NETFILTER=y
CONFIG_NF_CONNTRACK=y
CONFIG_NF_CONNTRACK_SECMARK=y
CONFIG_NF_CONNTRACK_EVENTS=y
CONFIG_NF_CT_PROTO_DCCP=y
CONFIG_NF_CT_PROTO_SCTP=y
CONFIG_NF_CT_PROTO_UDPLITE=y
CONFIG_NF_CONNTRACK_AMANDA=y
CONFIG_NF_CONNTRACK_FTP=y
CONFIG_NF_CONNTRACK_H323=y
CONFIG_NF_CONNTRACK_IRC=y
CONFIG_NF_CONNTRACK_NETBIOS_NS=y
CONFIG_NF_CONNTRACK_PPTP=y
CONFIG_NF_CONNTRACK_SANE=y
CONFIG_NF_CONNTRACK_TFTP=y
CONFIG_NF_CT_NETLINK=y
CONFIG_NETFILTER_XT_TARGET_CLASSIFY=y
CONFIG_NETFILTER_XT_TARGET_CONNMARK=y
CONFIG_NETFILTER_XT_TARGET_CONNSECMARK=y
CONFIG_NETFILTER_XT_TARGET_CT=y
CONFIG_NETFILTER_XT_TARGET_IDLETIMER=y
CONFIG_NETFILTER_XT_TARGET_MARK=y
CONFIG_NETFILTER_XT_TARGET_NFLOG=y
CONFIG_NETFILTER_XT_TARGET_NFQUEUE=y
CONFIG_NETFILTER_XT_TARGET_TPROXY=y
CONFIG_NETFILTER_XT_TARGET_TRACE=y
CONFIG_NETFILTER_XT_TARGET_SECMARK=y
CONFIG_NETFILTER_XT_TARGET_TCPMSS=y
CONFIG_NETFILTER_XT_MATCH_COMMENT=y
CONFIG_NETFILTER_XT_MATCH_CONNBYTES=y
CONFIG_NETFILTER_XT_MATCH_CONNLABEL=y
CONFIG_NETFILTER_XT_MATCH_CONNLIMIT=y
CONFIG_NETFILTER_XT_MATCH_CONNMARK=y
CONFIG_NETFILTER_XT_MATCH_CONNTRACK=y
CONFIG_NETFILTER_XT_MATCH_HASHLIMIT=y
CONFIG_NETFILTER_XT_MATCH_HELPER=y
CONFIG_NETFILTER_XT_MATCH_IPRANGE=y
CONFIG_NETFILTER_XT_MATCH_LENGTH=y
CONFIG_NETFILTER_XT_MATCH_LIMIT=y
CONFIG_NETFILTER_XT_MATCH_MAC=y
CONFIG_NETFILTER_XT_MATCH_MARK=y
CONFIG_NETFILTER_XT_MATCH_POLICY=y
CONFIG_NETFILTER_XT_MATCH_PKTTYPE=y
CONFIG_NETFILTER_XT_MATCH_QTAGUID=y
CONFIG_NETFILTER_XT_MATCH_QUOTA=y
CONFIG_NETFILTER_XT_MATCH_QUOTA2=y
CONFIG_NETFILTER_XT_MATCH_SCTP=y
CONFIG_NETFILTER_XT_MATCH_SOCKET=y
CONFIG_NETFILTER_XT_MATCH_STATE=y
CONFIG_NETFILTER_XT_MATCH_STATISTIC=y
CONFIG_NETFILTER_XT_MATCH_STRING=y
CONFIG_NETFILTER_XT_MATCH_TIME=y
CONFIG_NETFILTER_XT_MATCH_U32=y
CONFIG_NF_CONNTRACK_IPV4=y
CONFIG_IP_NF_IPTABLES=y
CONFIG_IP_NF_MATCH_AH=y
CONFIG_IP_NF_MATCH_ECN=y
CONFIG_IP_NF_MATCH_TTL=y
CONFIG_IP_NF_FILTER=y
CONFIG_IP_NF_TARGET_REJECT=y
CONFIG_IP_NF_NAT=y
CONFIG_IP_NF_TARGET_MASQUERADE=y
CONFIG_IP_NF_TARGET_NETMAP=y
CONFIG_IP_NF_TARGET_REDIRECT=y
CONFIG_IP_NF_MANGLE=y
CONFIG_IP_NF_RAW=y
CONFIG_IP_NF_SECURITY=y
CONFIG_IP_NF_ARPTABLES=y
CONFIG_IP_NF_ARPFILTER=y
CONFIG_IP_NF_ARP_MANGLE=y
CONFIG_NF_CONNTRACK_IPV6=y
CONFIG_IP6_NF_IPTABLES=y
CONFIG_IP6_NF_FILTER=y
CONFIG_IP6_NF_TARGET_REJECT=y
CONFIG_IP6_NF_MANGLE=y
CONFIG_IP6_NF_RAW=y
CONFIG_PHONET=y
CONFIG_NET_SCHED=y
CONFIG_NET_SCH_HTB=y
CONFIG_NET_SCH_INGRESS=y
CONFIG_NET_CLS_U32=y
CONFIG_NET_EMATCH=y
CONFIG_NET_EMATCH_U32=y
CONFIG_NET_CLS_ACT=y
CONFIG_NET_ACT_POLICE=y
CONFIG_NET_ACT_GACT=y
CONFIG_NET_ACT_MIRRED=y
CONFIG_CFG80211=y
CONFIG_UEVENT_HELPER_PATH="/sbin/hotplug"
CONFIG_DEVTMPFS=y
CONFIG_FW_LOADER_USER_HELPER_FALLBACK=y
CONFIG_BLK_DEV_LOOP=y
CONFIG_BLK_DEV_RAM=y
CONFIG_BLK_DEV_RAM_SIZE=8192
CONFIG_MCU_IPC=y
CONFIG_SHM_IPC=y
CONFIG_SEC_SIPC_MODEM_IF=y
# CONFIG_CP_ZEROCOPY is not set
CONFIG_SCSI=y
CONFIG_BLK_DEV_SD=y
CONFIG_MD=y
CONFIG_BLK_DEV_DM=y
CONFIG_DM_CRYPT=y
CONFIG_DM_UEVENT=y
CONFIG_DM_VERITY=y
CONFIG_INPUT_EVDEV=y
CONFIG_INPUT_KEYRESET=y
CONFIG_KEYBOARD_GPIO=y
CONFIG_KEYBOARD_SAMSUNG=y
# CONFIG_INPUT_MOUSE is not set
CONFIG_INPUT_JOYSTICK=y
CONFIG_INPUT_TABLET=y
CONFIG_INPUT_TOUCHSCREEN=y
CONFIG_TOUCHSCREEN_SYNAPTICS_I2C_DSX=y
CONFIG_INPUT_MISC=y
CONFIG_INPUT_KEYCHORD=y
CONFIG_INPUT_UINPUT=y
CONFIG_INPUT_GPIO=y
# CONFIG_SERIO_SERPORT is not set
# CONFIG_VT is not set
# CONFIG_LEGACY_PTYS is not set
# CONFIG_DEVMEM is not set
# CONFIG_DEVKMEM is not set
CONFIG_SERIAL_SAMSUNG=y
CONFIG_SERIAL_SAMSUNG_CONSOLE=y
# CONFIG_HW_RANDOM is not set
CONFIG_I2C_CHARDEV=y
CONFIG_I2C_S3C2410=y
CONFIG_SPI=y
CONFIG_SPI_S3C64XX=y
CONFIG_PINCTRL_EXYNOS=y
CONFIG_GPIOLIB=y
# CONFIG_HWMON is not set
CONFIG_WATCHDOG=y
CONFIG_S3C2410_WATCHDOG=y
CONFIG_MFD_S2MPU08=y
CONFIG_REGULATOR_S2MPU08=y
CONFIG_MEDIA_SUPPORT=y
CONFIG_MEDIA_CAMERA_SUPPORT=y
CONFIG_MEDIA_RADIO_SUPPORT=y
CONFIG_V4L_PLATFORM_DRIVERS=y
CONFIG_RADIO_ADAPTERS=y
CONFIG_RADIO_S5E7885=y
CONFIG_RADIO_S610=y
CONFIG_MALI_TMIX=y
CONFIG_MALI_MIDGARD=y
CONFIG_MALI_DEBUG_SYS=y
CONFIG_MALI_PLATFORM_THIRDPARTY_NAME="exynos"
CONFIG_EXYNOS_SOC_NAME="7885"
CONFIG_MALI_SYSTRACE_SUPPORT=y
# CONFIG_MALI_DVFS is not set
CONFIG_MALI_EXYNOS_TRACE=y
CONFIG_MALI_GPU_CORE_MASK_SELECTION=y
CONFIG_FB=y
CONFIG_FB_SIMPLE=y
CONFIG_EXYNOS_VIDEO=y
CONFIG_EXYNOS_MIPI_DSI=y
CONFIG_FB_WINDOW_UPDATE=y
CONFIG_EXYNOS_DECON_LCD=y
CONFIG_EXYNOS_DECON_LCD_S6E3FA0=y
CONFIG_BACKLIGHT_LCD_SUPPORT=y
# CONFIG_BACKLIGHT_GENERIC is not set
CONFIG_USB=y
CONFIG_USB_XHCI_HCD=y
CONFIG_USB_DWC3=y
CONFIG_USB_GADGET=y
CONFIG_USB_CONFIGFS=y
CONFIG_USB_CONFIGFS_ACM=y
CONFIG_USB_CONFIGFS_RNDIS=y
CONFIG_USB_CONFIGFS_F_DM=y
CONFIG_USB_CONFIGFS_F_ADB=y
CONFIG_USB_CONFIGFS_F_MTP=y
CONFIG_USB_CONFIGFS_F_PTP=y
CONFIG_USB_CONFIGFS_UEVENT=y
CONFIG_USB_RNDIS_MULTIPACKET=y
CONFIG_MMC=y
CONFIG_MMC_DW=y
CONFIG_MMC_DW_IDMAC=y
CONFIG_MMC_DW_64BIT_DESC=y
CONFIG_MMC_DW_EXYNOS=y
CONFIG_MMC_DW_DEBUG=y
CONFIG_MMC_DW_FORCE_32BIT_SFR_RW=y
CONFIG_MMC_CQ_HCI=y
CONFIG_RTC_CLASS=y
CONFIG_RTC_DRV_S2MPU08=y
CONFIG_DMADEVICES=y
CONFIG_STAGING=y
CONFIG_ASHMEM=y
CONFIG_ANDROID_TIMED_GPIO=y
CONFIG_ANDROID_LOW_MEMORY_KILLER=y
CONFIG_SYNC=y
CONFIG_SW_SYNC=y
CONFIG_SW_SYNC_USER=y
CONFIG_ION=y
CONFIG_ION_TEST=n
CONFIG_ION_EXYNOS=y
CONFIG_EXYNOS_IOMMU=y
CONFIG_SOC_SAMSUNG=y
CONFIG_EXYNOS_CHIPID=y
CONFIG_EXYNOS_PMU=y
CONFIG_EXYNOS_REBOOT=y
CONFIG_EXYNOS_PD=y
CONFIG_EXYNOS_RGT=y
CONFIG_CAL_IF=y
CONFIG_CP_PMUCAL=y
CONFIG_CMUCAL_DEBUG=y
CONFIG_CMUCAL_QCH_IGNORE_SUPPORT=y
# CONFIG_ACPM_DVFS is not set
CONFIG_USI=y
CONFIG_EXYNOS_KERNEL_PROTECTION=y
CONFIG_EXYNOS_ACPM=y
CONFIG_PM_DEVFREQ=y
CONFIG_ARM_EXYNOS_DEVFREQ=y
CONFIG_ARM_EXYNOS_DEVFREQ_DEBUG=y
CONFIG_IIO=y
CONFIG_EXYNOS_ADC=y
CONFIG_PWM=y
CONFIG_PWM_SAMSUNG=y
CONFIG_BATTERY_SAMSUNG=y
CONFIG_BATTERY_SWELLING=y
CONFIG_BATTERY_SAMSUNG_V2=y
# CONFIG_PHY_EXYNOS_MIPI_VIDEO is not set
# CONFIG_PHY_EXYNOS_DP_VIDEO is not set
CONFIG_PHY_EXYNOS_USBDRD3=y
CONFIG_ANDROID=y
CONFIG_ANDROID_BINDER_IPC=y
# CONFIG_EXYNOS_ITMON is not set
# CONFIG_EXYNOS_SNAPSHOT_SPINLOCK is not set
# CONFIG_EXYNOS_SNAPSHOT_REGULATOR is not set
# CONFIG_EXYNOS_SNAPSHOT_I2C is not set
# CONFIG_EXYNOS_SNAPSHOT_SPI is not set
CONFIG_EXT2_FS=y
CONFIG_EXT3_FS=y
CONFIG_EXT4_FS_SECURITY=y
CONFIG_EXT4_ENCRYPTION=y
CONFIG_EXT4_PRIVATE_ENCRYPTION=y
CONFIG_QUOTA=y
CONFIG_FUSE_FS=y
CONFIG_MSDOS_FS=y
CONFIG_VFAT_FS=y
CONFIG_TMPFS=y
CONFIG_TMPFS_POSIX_ACL=y
CONFIG_ECRYPT_FS=y
CONFIG_CRAMFS=y
CONFIG_NLS_CODEPAGE_437=y
CONFIG_NLS_ISO8859_1=y
CONFIG_PRINTK_TIME=y
CONFIG_PRINTK_PROCESS=y
CONFIG_DEBUG_INFO=y
CONFIG_SLUB_DEBUG_ON=y
CONFIG_LOCKUP_DETECTOR=y
CONFIG_BOOTPARAM_HARDLOCKUP_PANIC=y
CONFIG_BOOTPARAM_SOFTLOCKUP_PANIC=y
CONFIG_PANIC_TIMEOUT=5
CONFIG_SCHEDSTATS=y
CONFIG_TIMER_STATS=y
CONFIG_DEBUG_RT_MUTEXES=y
CONFIG_DEBUG_LOCK_ALLOC=y
CONFIG_DEBUG_ATOMIC_SLEEP=y
CONFIG_DEBUG_LIST=y
CONFIG_ENABLE_DEFAULT_TRACERS=y
CONFIG_ATOMIC64_SELFTEST=y
CONFIG_DEBUG_RODATA=y
CONFIG_SECURITY_PERF_EVENTS_RESTRICT=y
CONFIG_SECURITY=y
CONFIG_SECURITYFS=y
CONFIG_SECURITY_NETWORK=y
CONFIG_SECURITY_SELINUX=y
CONFIG_SECURITY_SELINUX_BOOTPARAM=y
CONFIG_EXYNOS_SMU=y
CONFIG_EXYNOS_FMP=y
CONFIG_SECURE_OS_CONTROL=y
CONFIG_SECURE_OS_BOOSTER_API=y
CONFIG_SCSC_CORE_CM=y
CONFIG_SCSC_CORE=y
CONFIG_SCSC_PLATFORM=y
CONFIG_SCSC_CM_MX_CLIENT_TEST=y
CONFIG_SCSC_MMAP=y
CONFIG_SCSC_DBG_SAMPLER=y
CONFIG_SCSC_BT=y
CONFIG_SCSC_WLAN=y
CONFIG_SCSC_WLAN_DEBUG=y
CONFIG_SCSC_WLBTD=y
CONFIG_SCSC_DEBUG=y
CONFIG_SCSC_DEBUG_COMPATIBILITY=y
CONFIG_SCSC_STATIC_RING=y
CONFIG_SCSC_STATIC_RING_SIZE=1048576
CONFIG_PHY_EXYNOS_MIPI=y
CONFIG_VIDEO_EXYNOS_FIMC_IS2=y
CONFIG_USE_CSI_DMAOUT_FEATURE=y
CONFIG_CAMERA_CIS_3M3_OBJ=y
CONFIG_CAMERA_CIS_2P8_OBJ=y
CONFIG_CAMERA_CIS_2L7_OBJ=y
CONFIG_CAMERA_ACT_AK7345_OBJ=y
CONFIG_CAMERA_ACT_AK7372_OBJ=y
CONFIG_CAMERA_FLASH_GPIO_OBJ=y
CONFIG_USE_SENSOR_GROUP=y
CONFIG_VIDEO_EXYNOS_CAMREA_POSTPROCESS=y
CONFIG_VIDEO_EXYNOS_CAMREA_POSTPROCESS_GDC=y
CONFIG_CAMERA_PP_GDC_V1_1_0_OBJ=y
CONFIG_VIDEOBUF2_CORE=y
CONFIG_VIDEOBUF2_MEMOPS=y
CONFIG_VIDEO_V4L2=y
```
